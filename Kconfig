## Kconfig
```kconfig
# agent Kconfig (内核风格: source 子Kconfig)
mainmenu "Agent Configuration"

source "arch/Kconfig"

menu "Agent Extensions"
config AGENT_EXTENSIONS_ENABLED
    bool "Agent扩展系统"
    default y

config INTENT_GATE_ENABLED
    bool "意图LLM分类"
    default y
    help
      每条用户消息调用 LLM 判定意图（IMPLEMENT/FIX/QA/INVESTIGATE/OPEN）。
      关闭时所有消息按 OPEN 处理。

config PLAN_REVIEW_ENABLED
    bool "计划评审"
    default y

config TEAM_MODE_ENABLED
    bool "Team Mode"
    default y

config RALPH_LOOP_ENABLED
    bool "Ralph Loop"
    default y

config MODEL_FALLBACK_ENABLED
    bool "模型回退"
    default y

config TODO_ENFORCER_ENABLED
    bool "待办强制执行"
    default y

config RULES_INJECTION_ENABLED
    bool "规则注入"
    default y

config PROMETHEUS_INTERVIEW_ENABLED
    bool "Prometheus访谈模式"
    default y

config SKILL_SCOPED_TOOLS_ENABLED
    bool "Skill内嵌工具"
    default y

config COMPACTION_RECOVERY_ENABLED
    bool "压缩恢复"
    default y

config SESSION_RECOVERY_ENABLED
    bool "会话恢复"
    default y
endmenu

source "kernel/Kconfig"
source "drivers/llm/Kconfig"
source "drivers/channel/Kconfig"

menu "Other Drivers"
config ENABLE_VISION
    bool "图像理解"
    default y

config ENABLE_SKILLS
    bool "Skill系统"
    default y

config ENABLE_MEMORY
    bool "会话记忆"
    default y
endmenu
```

## arch/Kconfig
```kconfig
choice
    prompt "Target Architecture"
    default ARCH_HOST
config ARCH_HOST
    bool "x86_64 Linux PC"
config ARCH_MIPS
    bool "MIPS 嵌入式"
config ARCH_ARM
    bool "ARM 嵌入式"
endchoice
```

## daiba/Kconfig
```kconfig
menu "Daiba Agent"

config AGENT_COORDINATOR
	bool "多Agent并行协调器"
	default y
	help
	  启用coordinator: PLANNER+EXECUTOR+REVIEWER并行执行

config AGENT_INTENT_GATE
	bool "意图分类门控"
	default y
	help
	  启用意图分类门控，在进入Agent主循环前判断请求意图。

config AGENT_CATEGORY_ROUTER
	bool "任务类别路由器"
	default y
	help
	  启用category router，根据任务类别选择不同执行策略。

config AGENT_PLAN_REVIEW
	bool "计划评审"
	default y
	help
	  启用计划评审扩展，在执行前检查计划质量。

config AGENT_TEAM_MODE
	bool "Team Mode"
	default y
	help
	  启用多角色Team Mode能力。

config AGENT_RALPH_LOOP
	bool "Ralph Loop"
	default y
	help
	  启用Ralph自循环执行扩展。

config DAIMA_ENABLE_VISION
	bool "图像理解"
	default y
	help
	  启用图像抓拍与多模态相关编译开关。

config DAIMA_ENABLE_VOICE
	bool "语音通道"
	default y
	help
	  启用语音通道、TTS和唤醒相关驱动。

config DAIMA_ENABLE_FEISHU
	bool "飞书通道"
	default y
	help
	  启用飞书WebSocket、事件处理与媒体接口。

config DAIMA_ENABLE_VECTOR
	bool "Vector机器人通道"
	default y
	help
	  启用Vector机器人MCP通道与动作工具。

config DAIMA_ENABLE_GATEWAY
	bool "Web网关"
	default y
	help
	  启用Host WebSocket/HTTP网关。

config DAIMA_ENABLE_CRON
	bool "定时任务"
	default y
	help
	  启用cron服务与相关工具。

config DAIMA_ENABLE_SKILLS
	bool "Skill系统"
	default y
	help
	  启用Skill加载器、元数据和Skill工具。

config DAIMA_ENABLE_MEMORY
	bool "会话记忆"
	default y
	help
	  启用会话存储、摘要、事实与历史推理。

config DAIMA_ENABLE_WORK_ITEMS
	bool "工作项"
	default y
	help
	  启用工作项存储和工具。

endmenu
```

## daima/Kconfig
```kconfig
# daima-agent Kconfig (内核风格: source 子Kconfig)
mainmenu "daima-agent Configuration"

source "daima/arch/Kconfig"

menu "Agent Extensions"
config AGENT_EXTENSIONS_ENABLED
    bool "Agent扩展系统"
    default y

config DAIMA_INTENT_GATE_ENABLED
    bool "意图分类门控"
    default y

config DAIMA_PLAN_REVIEW_ENABLED
    bool "计划评审"
    default y

config DAIMA_TEAM_MODE_ENABLED
    bool "Team Mode"
    default y

config DAIMA_RALPH_LOOP_ENABLED
    bool "Ralph Loop"
    default y

config DAIMA_MODEL_FALLBACK_ENABLED
    bool "模型回退"
    default y

config DAIMA_TODO_ENFORCER_ENABLED
    bool "待办强制执行"
    default y

config DAIMA_RULES_INJECTION_ENABLED
    bool "规则注入"
    default y

config DAIMA_PROMETHEUS_INTERVIEW_ENABLED
    bool "Prometheus访谈模式"
    default y

config DAIMA_SKILL_SCOPED_TOOLS_ENABLED
    bool "Skill内嵌工具"
    default y

config DAIMA_COMPACTION_RECOVERY_ENABLED
    bool "压缩恢复"
    default y

config DAIMA_SESSION_RECOVERY_ENABLED
    bool "会话恢复"
    default y
endmenu

source "daima/kernel/Kconfig"
source "daima/drivers/llm/Kconfig"
source "daima/drivers/channel/Kconfig"

menu "Other Drivers"
config DAIMA_ENABLE_VISION
    bool "图像理解"
    default y

config DAIMA_ENABLE_SKILLS
    bool "Skill系统"
    default y

config DAIMA_ENABLE_MEMORY
    bool "会话记忆"
    default y
endmenu
```

## daima/arch/Kconfig
```kconfig
choice
	prompt "目标平台"
	default ARCH_HOST

config ARCH_HOST
	bool "x86_64 Linux PC"

config ARCH_MIPS
	bool "MIPS 嵌入式"

config ARCH_ARM
	bool "ARM 嵌入式"

endchoice
```

## daima/drivers/llm/Kconfig
```kconfig
menu "LLM Driver"
config DAIMA_LLM_OPENAI
    bool "OpenAI 协议支持"
    default y
config DAIMA_LLM_ANTHROPIC
    bool "Anthropic 协议支持"
    default y
endmenu
```

## daima/kernel/Kconfig
```kconfig
menu "Kernel Features"
source "daima/kernel/sched/Kconfig"
source "daima/kernel/time/Kconfig"
config DAIMA_KERNEL_WORKQUEUE
    bool "Workqueue 支持"
    default y
endmenu
```

## drivers/channel/Kconfig
```kconfig
menu "Channel Drivers"
config FEISHU_ENABLED
    bool "飞书通道"
    default y
config VECTOR_ENABLED
    bool "Vector 机器人通道"
    default y
config GATEWAY_ENABLED
    bool "WebSocket 网关"
    default y
endmenu
```

## drivers/llm/Kconfig
```kconfig
menu "LLM Driver"
config LLM_OPENAI
    bool "OpenAI 协议支持"
    default y
config LLM_ANTHROPIC
    bool "Anthropic 协议支持"
    default y
endmenu
```

## kernel/Kconfig
```kconfig
menu "Kernel Features"
config PRINTK
    bool "printk 日志子系统"
    default y

config IRQ
    bool "IRQ 中断框架"
    default y

config SYSCTL
    bool "sysctl 运行时参数"
    default y

source "kernel/sched/Kconfig"
source "kernel/time/Kconfig"
config KERNEL_WORKQUEUE
    bool "Workqueue 支持"
    default y
endmenu
```

## kernel/sched/Kconfig
```kconfig
menu "Scheduler"
config SCHED_COORDINATOR
    bool "多Agent并行调度"
    default y
    help
      PLANNER + EXECUTOR + REVIEWER 并行执行
endmenu
```
